## CMakeLists.txt
```
cmake_minimum_required(VERSION 3.20.0)

# Allow Zephyr to find this lab's local DT binding
list(APPEND DTS_ROOT "${CMAKE_CURRENT_SOURCE_DIR}")

find_package(Zephyr REQUIRED HINTS $ENV{ZEPHYR_BASE})

project(lab26_dma_transfer_queue_zephyr LANGUAGES C)

target_sources(app PRIVATE
	src/main.c
	src/dma_queue.c
	src/dma_sim.c
)

target_include_directories(app PRIVATE
	"${CMAKE_CURRENT_SOURCE_DIR}/src"
)
```

## prj.conf
```kconfig
#
# The CMSDK driver routes its first expiration through the runtime NMI handler
#
CONFIG_DMA=y

# Sparse progress messages
CONFIG_SERIAL=y
CONFIG_CONSOLE=y
CONFIG_UART_CONSOLE=y
CONFIG_PRINTK=y
CONFIG_LOG=n

#
# Real threads and GDB-friendly code
#
CONFIG_DEBUG=y
CONFIG_NO_OPTIMIZATIONS=y
CONFIG_ASSERT=y

#
# Runtime
#
CONFIG_MAIN_STACK_SIZE=2048
```

## app.overlay
```dts
/*
* No physical DMA controller is required
*/
```

## src/main.c
```c
#include "dma_queue.h"
#include "dma_sim.h"

#include <errno.h>
#include <string.h>

#include <zephyr/kernel.h>
#include <zephyr/sys/printk.h>

#define TRANSFER_COUNT 5U
#define BYTES_PER_TRANSFER 8U

static struct dma_queue queue;
static uint8_t sources[TRANSFER_COUNT + 1U][BYTES_PER_TRANSFER];
static uint8_t destinations[TRANSFER_COUNT + 1U][BYTES_PER_TRANSFER];

volatile unsigned int lab26_stage;
volatile unsigned int last_stage;
volatile int lab26_last_rc;

__attribute__((noinline)) void lab26_checkpoint(void) {
    __asm__ volatile ("nop");
}

int main(void) {
    const struct device *dev = dma_sim_device();

    /* Stage 1. Init */
    lab26_stage = 1U;
    lab26_last_rc = dma_queue_init(&queue, dev, 0U);
    if (lab26_last_rc != 0) {
        printk("LAB26 FAIL init=%d\n", lab26_last_rc);
	return 1;
    }

    printk("LAB26 INIT channel=0 pending_capacity=4\n");
    lab26_checkpoint();

    for (unsigned int i = 0U; i < TRANSFER_COUNT + 1U; ++i) {
        memset(sources[i], (int)(0x41U + i), BYTES_PER_TRANSFER);
    }

    /* Stage 2. Submit */
    lab26_stage = 2U;
    for (unsigned int i = 0U; i < TRANSFER_COUNT; ++i) {
        lab26_last_rc = dma_queue_submit(&queue, sources[i], destinations[i], BYTES_PER_TRANSFER);

	if (lab26_last_rc != 0) {
	    printk("LAB26 FAIL submit[%u]=%d\n", i, lab26_last_rc);
	    return 1;
	}
    }

    printk("LAB26 QUEUED active=1 waiting=%u\n", queue.count);
    lab26_checkpoint();

    lab26_last_rc = dma_queue_submit(&queue, sources[5], destinations[5], BYTES_PER_TRANSFER);

    if (lab26_last_rc != -ENOSPC) {
        printk("LAB26 FAIL full=%d\n", lab26_last_rc);
	return 1;
    }
    printk("LAB26 FULL rejected=%d\n", lab26_last_rc);

    /* Stage 3. Wait */
    lab26_stage = 3U;
    for (unsigned int i = 0U; i < TRANSFER_COUNT; ++i) {
        if (dma_sim_wait(K_SECONDS(2)) != 0) {
	    printk("LAB26 FAIL timeout at transfer=%u\n", i);
	    return 1;
	}
    }
    lab26_checkpoint();

    for (unsigned int i = 0U; i < TRANSFER_COUNT; ++i) {
        if (memcmp(sources[i], destinations[i], BYTES_PER_TRANSFER) != 0) {
	    printk("LAB26 FAIL data mismatch at transfer=%u\n", i);
	    return 1;
	}
    }

    if (queue.completed != TRANSFER_COUNT || queue.failed != 0U ||
	queue.busy || queue.count != 0U) {
        printk("LAB26 FAIL state: done=%u failed=%u busy=%u queued=%u\n", queue.completed, queue.failed, 
		(unsigned int)queue.busy, queue.count);
	return 1;
    }

    /* Stage 4. Complete */
    last_stage = 4U;
    printk("LAB26 PASS completed=%u failed=%u FIFO=5\n", queue.completed, queue.failed);
    lab26_checkpoint();

    return 0;

}
```

## src/dma_queue.c
```c
#include "dma_queue.h"

#include <errno.h>
#include <limits.h>
#include <stdint.h>

static int start_next(struct dma_queue *queue);

static void completion_callback(const struct device *dev, void *user_data, uint32_t channel, int status) {
    struct dma_queue *queue = user_data;

    if (queue != NULL && dev == queue->dev && channel == queue->channel) {
        dma_queue_on_complete(queue, status);
    }
}

int dma_queue_init(struct dma_queue *queue, const struct device *dev, uint32_t channel) {
    if (queue == NULL || dev == NULL)
        return -EINVAL;

    if (!device_is_ready(dev))
	return -ENODEV;

    *queue = (struct dma_queue){0};

    queue->dev = dev;
    queue->channel = channel;

    queue->block.source_addr_adj = DMA_ADDR_ADJ_INCREMENT;
    queue->block.dest_addr_adj = DMA_ADDR_ADJ_INCREMENT;

    queue->config.channel_direction = MEMORY_TO_MEMORY;
    queue->config.source_data_size = 1U;
    queue->config.dest_data_size = 1U;
    queue->config.source_burst_length = 1U;
    queue->config.dest_burst_length = 1U;
    queue->config.block_count = 1U;
    queue->config.head_block = &queue->block;
    queue->config.dma_callback = completion_callback;
    queue->config.user_data = queue;

    return 0;
}

/* The only routine that transfers ownership of a queued request to DMA */
static int start_next(struct dma_queue *queue) {
    int first_error = 0;

    while (!queue->busy && queue->count != 0U) {
        const struct dma_request req = queue->pending[queue->head];

	queue->head = (queue->head + 1U) % DMA_QUEUE_CAPACITY;
	--queue->count;

	queue->block.source_address = (uintptr_t)req.src;
	queue->block.dest_address = (uintptr_t)req.dst;
	queue->block.block_size = (uint32_t)req.len;

	/* Claim the channel before strating an asynchronous operation */
	queue->busy = true;

	int rc = dma_config(queue->dev, queue->channel, &queue->config);
	if (rc == 0) {
	    rc = dma_start(queue->dev, queue->channel);
	}

	if (rc == 0) {
            return first_error;	
	}

	/* A rejected request is dropped and reported through counters */
	queue->busy = false;
	queue->last_status = rc;
	++queue->failed;

	if (first_error == 0)
	    first_error = rc;
    }

    return first_error;
}

int dma_queue_submit(struct dma_queue *queue, const void *src, void *dst, size_t len) {
    if (queue == NULL || queue->dev == NULL || src == NULL || dst == NULL || len == 0U)
	return -EINVAL;

#if SIZE_MAX > UINT32_MAX
    if (len > UINT32_MAX)
	return -E2BIG;
#endif

#ifndef CONFIG_DMA_64BIT
    /* Zephyr's 32-bit DMA descriptors must represent the full address span */
    const uintptr_t source = (uintptr_t) src;
    const uintptr_t destination = (uintptr_t) dst;
#if UINTPTR_MAX > UINT32_MAX
    if (source > UINT32_MAX || destionation > UINT32_MAX) {
        return -ERANGE;
    }
#endif
    if (len -1U > UINT32_MAX - source || len - 1U > UINT32_MAX - destination) {
        return -ERANGE;
    }
#endif

    if (queue->count == DMA_QUEUE_CAPACITY)
	return -ENOSPC;

    const unsigned int tail = (queue->head + queue->count) % DMA_QUEUE_CAPACITY;

    queue->pending[tail] = (struct dma_request) {src, dst, len};
    ++queue->count;

    return queue->busy ? 0 : start_next(queue);
}

void dma_queue_on_complete(struct dma_queue *queue, int status) {
     if (queue == NULL || !queue->busy || status > DMA_STATUS_COMPLETE) {
         return;
     }

     queue->busy = false;
     queue->last_status = status;

     if (status == DMA_STATUS_COMPLETE) {
         ++queue->completed;
     } else {
         ++queue->failed;
     }

     (void) start_next(queue);
}
```

## src/dma_queue.h
```c
#ifndef LAB26_DMA_QUEUE_H_
#define LAB26_DMA_QUEUE_H_

#include <stdbool.h>
#include <stddef.h>
#include <stdint.h>

#include <zephyr/device.h>
#include <zephyr/drivers/dma.h>

#define DMA_QUEUE_CAPACITY 4U

struct dma_request {
    const void *src;
    void *dst;
    size_t len;
};

/* Single-channel */
struct dma_queue {
    const struct device *dev;
    uint32_t channel;
    struct dma_request pending[DMA_QUEUE_CAPACITY];
    unsigned int head;
    unsigned int count;
    bool busy;

    /* Persistent descriptors */
    struct dma_block_config block;
    struct dma_config config;

    unsigned int completed;
    unsigned int failed;
    int last_status;
};

int dma_queue_init(struct dma_queue *queue, const struct device *dev, uint32_t channel);
int dma_queue_submit(struct dma_queue *queue, const void *src, void *dst, size_t len);
/* call only in a serialized thread/workqueue context */
void dma_queue_on_complete(struct dma_queue *queue, int status);

#endif
```

## src/dma_sim.c
```c
#include "dma_sim.h"

#include <errno.h>
#include <stdint.h>
#include <string.h>

#include <zephyr/drivers/dma.h>
#include <zephyr/sys/util.h>

struct dma_sim_data {
    const struct device *dev;
    struct k_timer timer;
    struct k_work complete_work;
    struct k_sem completion_sem;
    struct dma_config config;
    struct dma_block_config block;
    bool configured;
    bool running;
};

static struct dma_sim_data sim;

static void completed_work_handler(struct k_work *work) {
    struct dma_sim_data *data = CONTAINER_OF(work, struct dma_sim_data, complete_work);

    /* CPU memcpy is intentionally a simuation */
    memcpy((void *) (uintptr_t)data->block.dest_address, (const void *)(uintptr_t)data->block.source_address, data->block.block_size);

    data->running = false;
    data->config.dma_callback(data->dev, data->config.user_data, 0U, DMA_STATUS_COMPLETE);

    k_sem_give(&data->completion_sem);
}

static void timer_handler(struct k_timer *timer) {
    struct dma_sim_data *data = CONTAINER_OF(timer, struct dma_sim_data, timer);

    /* This timer expires in interrupt context */
    (void) k_work_submit(&data->complete_work);
}

static int sim_configure(const struct device *dev, uint32_t channel, struct dma_config *config) {
    struct dma_sim_data *data = dev->data;

    if (channel != 0U || config == NULL || config->head_block == NULL || 
	config->block_count != 1U || config->channel_direction != MEMORY_TO_MEMORY ||
	config->dma_callback == NULL) {
        return -EINVAL;
    }

    if (data->running)
	return -EBUSY;

    data->config = *config;
    data->block = *config->head_block;
    data->configured = true;

    return 0;
}

static int sim_start(const struct device *dev, uint32_t channel) {
    struct dma_sim_data *data = dev->data;

    if (channel != 0U || !data->configured) {
        return -EINVAL;
    }

    if (data->running)
	return -EBUSY;

    data->running = true;
    k_timer_start(&data->timer, K_MSEC(15), K_NO_WAIT);

    return 0;
}

static int sim_init(const struct device *dev) {
    struct dma_sim_data *data = dev->data;

    data->dev = dev;
    data->running = false;
    data->configured = false;

    k_timer_init(&data->timer, timer_handler, NULL);
    k_work_init(&data->complete_work, completed_work_handler);
    k_sem_init(&data->completion_sem, 0U, 16U);

    return 0;
}

static DEVICE_API(dma, sim_api) = {
    .config = sim_configure,
    .start = sim_start,
};

DEVICE_DEFINE(lab26_dma, "lab26_dma", sim_init, NULL, 
	      &sim, NULL, 
	      POST_KERNEL, CONFIG_KERNEL_INIT_PRIORITY_DEVICE, &sim_api);

const struct device *dma_sim_device(void) {
    return DEVICE_GET(lab26_dma);
}

int dma_sim_wait(k_timeout_t timeout) {
    return k_sem_take(&sim.completion_sem, timeout);
}
```

## src/dma_sim.h
```c
#ifndef LAB26_DMA_SIM_H_
#define LAB26_DMA_SIM_H_

#include <zephyr/device.h>
#include <zephyr/kernel.h>

/* Software-only controller */
const struct device *dma_sim_device(void);
int dma_sim_wait(k_timeout_t timeout);

#endif
```
