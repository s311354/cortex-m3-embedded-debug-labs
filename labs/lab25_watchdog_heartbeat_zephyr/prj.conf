## CMakeLists.txt
```
cmake_minimum_required(VERSION 3.20.0)

# Allow Zephyr to find this lab's local DT binding
list(APPEND DTS_ROOT "${CMAKE_CURRENT_SOURCE_DIR}")

find_package(Zephyr REQUIRED HINTS $ENV{ZEPHYR_BASE})

project(lab25_watchdog_heartbeat_zephyr LANGUAGES C)

target_sources(app PRIVATE
	src/main.c
	src/watchdog_supervisor.c
)

target_include_directories(app PRIVATE
	"${CMAKE_CURRENT_SOURCE_DIR}/src"
)
```

## prj.conf
```kconfig
#
# The CMSDK driver routes its first expiration through the runtime NMI handler
#
CONFIG_WATCHDOG=y
CONFIG_RUNTIME_NMI=y
CONFIG_WDOG_CMSDK_APB=y
CONFIG_WDOG_CMSDK_APB_START_AT_BOOT=n

# Sparse progress messages
CONFIG_SERIAL=y
CONFIG_CONSOLE=y
CONFIG_UART_CONSOLE=y
CONFIG_PRINTK=y
CONFIG_LOG=n

#
# Real threads and GDB-friendly code
#
CONFIG_DEBUG=y
CONFIG_NO_OPTIMIZATIONS=y
CONFIG_ASSERT=y

#
# Runtime
#
CONFIG_MAIN_STACK_SIZE=2048

# MPS2 already has a watchdog device
CONFIG_QEMU_EXTRA_FLAGS="-action watchdog=reset"
```

## app.overlay
```dts
/*
* Reuse MPS2's existing CMSDK APB watchdog and its existing clock phandle
*/
/ {
    aliases {
        watchdog0 = &wdog0;
    };
};

&wdog0 {
    status = "okay";
};
```

## src/main.c
```c
#include "watchdog_supervisor.h"

#include <stdint.h>

#include <zephyr/devicetree.h>
#include <zephyr/kernel.h>
#include <zephyr/sys/atomic.h>
#include <zephyr/sys/printk.h>
#include <zephyr/sys/util.h>

#define WDT_NODE       DT_ALIAS(watchdog0)
#define WORKER_STACK   1024U
#define WORKER_PRIO    5
#define SERVICE_MS     50U
#define NOT_RUN        (-999)

BUILD_ASSERT(DT_NODE_HAS_STATUS(WDT_NODE, okay), "watchdog0 must be enabled");
BUILD_ASSERT(DT_NODE_HAS_COMPAT(WDT_NODE, arm_cmsdk_watchdog), "CMSDK watchdog required");
BUILD_ASSERT(DT_REG_ADDR(WDT_NODE) == 0x40008000U, "MPS2 watchdog mapping differs");

static const struct device *const g_wdt = DEVICE_DT_GET(WDT_NODE);

static struct watchdog_ctx g_watchdog;
static struct k_thread g_workers[WATCHDOG_TASK_COUNT];
K_THREAD_STACK_ARRAY_DEFINE(g_worker_stacks, WATCHDOG_TASK_COUNT, WORKER_STACK);

/* atomics are for cross-thread demo telemetry/stall injection, not core policy */
atomic_t g_effective_stall_mask;
atomic_t g_observed_stall_mask;
atomic_t g_report_calls[WATCHDOG_TASK_COUNT];

volatile uint32_t g_auto_stall_after_feeds = 5U; /* Set 0 to stay healthy */
volatile uint32_t g_stall_mask = 0U; /* bit 0: task0, bit 1: task1 */

enum lab25_stage {
    LAB25_STAGE_RESET = 0,
    LAB25_STAGE_INIT,
    LAB25_STAGE_RUNNING,
    LAB25_STAGE_WAITING_FOR_RESET,
    LAB25_STAGE_ERROR,
};

volatile enum lab25_stage g_lab25_stage;

volatile int g_init_rc = NOT_RUN;
volatile int g_service_rc = NOT_RUN;
volatile int g_error_rc = NOT_RUN;
volatile int g_report_rc[WATCHDOG_TASK_COUNT] = {NOT_RUN, NOT_RUN};

volatile uint32_t g_work_units[WATCHDOG_TASK_COUNT];
volatile uint32_t g_successful_feeds;
volatile uint32_t g_waiting_services;
volatile uintptr_t g_watchdog_mmio_base;

__attribute__((noinline)) void lab25_checkpoint(void) {
    __asm__ volatile ("nop");
}

static void halt_without_feeding(int rc) {
    g_error_rc = rc;
    g_lab25_stage = LAB25_STAGE_ERROR;
    printk("LAB25 ERROR rc=%d; no more software feeds\n", rc);
    for (;;)
	k_sleep(K_FOREVER);
}

static void heartbeat_worker(void *arg, void *unused1, void *unused2) {
    const unsigned int id = (unsigned int)(uintptr_t) arg;
    const uint32_t period_ms = id == 0U ? 200U : 300U;
    uint32_t work_units = 0U;

    ARG_UNUSED(unused1);
    ARG_UNUSED(unused2);

    for (;;) {
        if (atomic_test_bit(&g_effective_stall_mask, id))  {
            /* Simulate a task that makes no further progress or reports */
	    atomic_set_bit(&g_observed_stall_mask, id);
	} else {
	    /* Placeholder for one completed unit of the worker's real work */
            ++work_units;
	    g_work_units[id] = work_units;

	    const int rc = watchdog_report(&g_watchdog, id);

	    g_report_rc[id] = rc;

	    if (rc != 0) {
                for (;;)
	            k_sleep(K_FOREVER);
	    }
	    atomic_inc(&g_report_calls[id]);
	}

	k_msleep(period_ms);
    }
}

int main(void) {
    g_watchdog_mmio_base = DT_REG_ADDR(WDT_NODE);

    /* Test 1. */
    g_lab25_stage = LAB25_STAGE_INIT;
    printk("LAB25 BOOT watchdog=0x%lx\n", (unsigned long)g_watchdog_mmio_base);
    lab25_checkpoint();

    g_init_rc = watchdog_init(&g_watchdog, g_wdt);

    if (g_init_rc != 0)
	halt_without_feeding(g_init_rc);

    for (unsigned int id = 0U; id < WATCHDOG_TASK_COUNT; ++id) {
        k_thread_create(&g_workers[id], g_worker_stacks[id],
			K_THREAD_STACK_SIZEOF(g_worker_stacks[id]),
			heartbeat_worker, (void *)(uintptr_t)id, NULL, NULL,
			WORKER_PRIO, 0U, K_NO_WAIT);
    }

    /* Test 2. */
    g_lab25_stage = LAB25_STAGE_RUNNING;
    printk("LAB25 START channel=%d reload_ms=%u\n", g_watchdog.channel_id, WATCHDOG_TIMEOUT_MS);
    lab25_checkpoint();

    uint32_t previous_stall_mask = 0U;

    for (;;) {
        if (g_auto_stall_after_feeds != 0U &&
	    g_successful_feeds >= g_auto_stall_after_feeds) {
	    /* The automatic demonstration stalls task 1 */
	    g_stall_mask |= 2U;
	}

	const uint32_t requested = g_stall_mask & WATCHDOG_REQUIRED_MASK;
	atomic_set(&g_effective_stall_mask, (atomic_val_t)requested);

	if (requested != previous_stall_mask) {
            previous_stall_mask = requested;

	    g_lab25_stage = requested != 0U ? LAB25_STAGE_WAITING_FOR_RESET : LAB25_STAGE_RUNNING;

	    printk("LAB25 STALL mask=%u feeds=%u\n", requested, g_successful_feeds);
	    lab25_checkpoint();
	}

	g_service_rc = watchdog_service(&g_watchdog);

	if (g_service_rc == 0) {
	    ++g_successful_feeds;
	    printk("LAB25 FEED %u\n", g_successful_feeds);
	} else if (g_service_rc == WATCHDOG_SERVICE_WAITING) {
	    ++g_waiting_services;
	} else {
	    halt_without_feeding(g_service_rc);
	}

	k_msleep(SERVICE_MS);
    }

    return 0;
}
```

## src/watchdog_supervisor.c
```c
#include "watchdog_supervisor.h"

#include <errno.h>
#include <stddef.h>

#include <zephyr/drivers/watchdog.h>

int watchdog_init(struct watchdog_ctx *ctx, const struct device *dev) {
    if (ctx == NULL || dev == NULL)
	return -EINVAL;

    if (k_is_in_isr())
	return -EWOULDBLOCK;

    if (ctx->state != WATCHDOG_UNINITIALIZED)
	return -EALREADY;

    if (!device_is_ready(dev))
	return -ENODEV;

    int rc = k_mutex_init(&ctx->lock);

    if (rc != 0)
	return rc;

    ctx->dev = dev;
    ctx->channel_id = -1;
    ctx->reported_mask = 0U; /* neither task reported */

    ctx->state = WATCHDOG_FAULTED;

    const struct wdt_timeout_cfg cfg = {
        .window = {
	    .min = 0U,
	    .max = WATCHDOG_TIMEOUT_MS
	},
	.callback = NULL,
	.flags = WDT_FLAG_RESET_SOC,
    };

    rc = wdt_install_timeout(dev, &cfg);

    if (rc < 0)
	return rc;

    ctx->channel_id = rc;

    rc = wdt_setup(dev, 0U);

    if (rc != 0)
	return rc;

    ctx->state = WATCHDOG_RUNNING;

    return 0;
}

int watchdog_report(struct watchdog_ctx *ctx, unsigned int task_id) {
    if (ctx == NULL || ctx->dev == NULL || task_id >= WATCHDOG_TASK_COUNT) {
        return -EINVAL;
    }

    if (k_is_in_isr())
	return -EWOULDBLOCK;

    int rc = k_mutex_lock(&ctx->lock, K_FOREVER);

    if (rc != 0)
	return rc;

    if (ctx->state != WATCHDOG_RUNNING) {
	rc = -EIO;
    } else {
        ctx->reported_mask |= (uint8_t)(1U << task_id);
	rc = 0;
    }

    k_mutex_unlock(&ctx->lock);
    return rc;
}

int watchdog_service(struct watchdog_ctx *ctx) {
    if (ctx == NULL || ctx->dev == NULL)
	return -EINVAL;

    if (k_is_in_isr())
	return -EWOULDBLOCK;

    int rc = k_mutex_lock(&ctx->lock, K_FOREVER);

    if (rc != 0)
	return rc;

    if (ctx->state != WATCHDOG_RUNNING) {
        rc = -EIO;
    } else if (ctx->reported_mask != WATCHDOG_REQUIRED_MASK) {
        rc = WATCHDOG_SERVICE_WAITING;
    } else {
        /* Hold the mutex through BOTH the feed and successful clearing */
        rc = wdt_feed(ctx->dev, ctx->channel_id);

	if (rc == 0) {
	    ctx->reported_mask = 0U;
	} else {
	    /* No clearing and no future feeds, including after -EAGAIN */
            ctx->state = WATCHDOG_FAULTED;
	}
    }

    k_mutex_unlock(&ctx->lock);
    return rc;
}
```

## src/watchdog_supervisor.h
```c
#ifndef LAB25_WATCHDOG_SUPERVISOR_H
#define LAB25_WATCHDOG_SUPERVISOR_H

#include <stdint.h>

#include <zephyr/device.h>
#include <zephyr/kernel.h>

#define WATCHDOG_TASK_COUNT       2U
#define WATCHDOG_REQUIRED_MASK    0x03U
#define WATCHDOG_TIMEOUT_MS       2000U
#define WATCHDOG_SERVICE_WAITING  1

enum watchdog_state {
    WATCHDOG_UNINITIALIZED = 0,
    WATCHDOG_RUNNING,
    WATCHDOG_FAULTED,
};

struct watchdog_ctx {
    const struct device *dev;

    int channel_id;
    uint8_t reported_mask;
    enum watchdog_state state;
    struct k_mutex lock;
};

int watchdog_init(struct watchdog_ctx *ctx, const struct device *dev);

int watchdog_report(struct watchdog_ctx *ctx, unsigned int task_id);

int watchdog_service(struct watchdog_ctx *ctx);


#endif
```
