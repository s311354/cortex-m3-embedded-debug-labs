## CMakeLists.txt
```
cmake_minimum_required(VERSION 3.20.0)

#
# Allow Zephyr to find the devicetree binding under:
#    dts/bindings/serial/
#
list(APPEND DTS_ROOT "${CMAKE_CURRENT_SOURCE_DIR}")
option(QEMU_PTY "Use a PTY for the Lab20 QEMU UART" ON)
find_package(Zephyr REQUIRED HINTS $ENV{ZEPHYR_BASE})
project(lab20_uart_async_rx_manager_zephyr LANGUAGES C)

target_sources(app PRIVATE
	src/main.c
	src/rx_manager.c
)

if (CONFIG_LAB20_CMSDK_UART_ASYNC)
	target_sources(app PRIVATE drivers/uart/uart_cmsdk_async.c)
endif()

target_include_directories(app PRIVATE "${CMAKE_CURRENT_SOURCE_DIR}/src")
```

## Kconfig
```
mainmenu "Lab20 UART Async RX Manager"
source "Kconfig.zephyr"

config LAB20_CMSDK_UART_ASYNC
	bool "Lab20 interrupt-backed CMSDK UART asynchronous RX"
	default y
	depends on SERIAL && CPU_CORTEX_M3 && !SMP
	depends on DT_HAS_LAB20_CMSDK_UART_ASYNC_ENABLED
	select SERIAL_HAS_DRIVER
	select SERIAL_SUPPORT_ASYNC
	help
	  Lab-local RX implementation of the Zephyr UART asynchronous API.
	  Uses UART RX interrupts, not DMA. Only SYS_FOREVER_US is supported.
	  All events are delivered by the UART ISR; callbacks must not block.
```

## prj.conf
```kconfig
#
# Serial
#
CONFIG_SERIAL=y
CONFIG_LAB20_CMSDK_UART_ASYNC=y
CONFIG_UART_ASYNC_API=y
CONFIG_UART_INTERRUPT_DRIVEN=n
CONFIG_UART_USE_RUNTIME_CONFIGURE=n

#
# Application receive queue
#
CONFIG_RING_BUFFER=y

#
# UART0 is owned by this lab
#
CONFIG_CONSOLE=n
CONFIG_UART_CONSOLE=n
CONFIG_PRINTK=n
CONFIG_LOG=n

#
# Debug-friendly build
#
CONFIG_DEBUG=y
CONFIG_NO_OPTIMIZATIONS=y
CONFIG_ASSERT=y

#
# Runtime
#
CONFIG_MAIN_STACK_SIZE=2024
CONFIG_SYSTEM_WORKQUEUE_STACK_SIZE=1024
```

## app.overlay
```dts
/*
* UART0 normally uses:
*    compatible = "arm,cmsdk-uart";
*
* Lab20 replaces only the driver binding.
*
* The existing:
*     reg
*     interrupts
*     clocks
*     current-speed
*
* properties remain inherited from the MPS2 board DTS
*/
&uart0 {
    compatible = "lab20,cmsdk-uart-async";
    status = "okay";
};
```

## dts/bindings/serial/lab20,cmsdk-uart-async.yaml
```yaml
description: Lab20 interrupt-backed CMSDK APB UART asynchronous RX
compatible: "lab20,cmsdk-uart-async"
include: uart-controller.yaml

properties:
  reg:
    required: true
  interrupts:
    required: true
  interrupt-names:
    required: true
  clocks:
    required: true
  current-speed:
    required: true
```

## src/main.c
```c
#include "rx_manager.h"
#include <zephyr/devicetree.h>
#include <zephyr/irq.h>
#include <zephyr/kernel.h>

static const struct device *const async_uart = DEVICE_DT_GET(DT_NODELABEL(uart0));
struct rx_manager g_rx_manager;

volatile bool g_consume_enabled = true;
volatile bool g_stop_requested;
volatile int g_init_rc;
volatile int g_stop_rc;

uint8_t g_last_read[16];
size_t g_last_read_len;
uint32_t g_total_read;
uint32_t g_ring_used;

__attribute__((noinline)) 
void lab20_ready(void) { 
    __asm__ volatile("" ::: "memory");
}

__attribute__((noinline))
void lab20_after_read(void) {
    __asm__ volatile("" ::: "memory");
}

int main(void) {
    g_init_rc = rx_manager_init(&g_rx_manager, async_uart);

    lab20_ready();

    if (g_init_rc != 0) {
        for (;;) {
	    k_sleep(K_FOREVER);
	}
    }

    for (;;) {
        if (g_stop_requested) {
	    g_stop_requested = false;
	    g_stop_rc = uart_rx_disable(async_uart);
	}

	if (g_consume_enabled) {
	    size_t n = rx_manager_read(&g_rx_manager, g_last_read, sizeof(g_last_read));

	    if (n != 0U) {
	        g_last_read_len = n;
		g_total_read += (uint32_t) n;
		lab20_after_read();
	    }
	}

	unsigned int key = irq_lock();
	g_ring_used = ring_buf_size_get(&g_rx_manager.app_ring);
	irq_unlock(key);
	k_sleep(K_MSEC(20));
    }

    return 0;
}
```

## src/rx_manager.c
```c
#include "rx_manager.h"

#include <errno.h>
#include <string.h>

#include <zephyr/irq.h>
#include <zephyr/kernel.h>
#include <zephyr/sys/util.h>

BUILD_ASSERT(!IS_ENABLED(CONFIG_SMP), "Lab20 uses single-core IRQ locking");

static int buffer_index(const struct rx_manager *mgr, const uint8_t *buf) {
    for (size_t i = 0; i < RX_DRIVER_COUNT; ++i) {
	if (buf == mgr->driver_buf[i])
            return (int)i;
    }

    return -1;
}

static void rx_uart_callback(const struct device *dev, struct uart_event *evt, void *user_data) {
    struct rx_manager *mgr = user_data;

    if (mgr != NULL && dev == mgr->dev)
        rx_manager_event(mgr, evt);
}

int rx_manager_init(struct rx_manager *mgr, const struct device *dev) {
    if (mgr == NULL || dev == NULL) 
	return -EINVAL;

    if (!device_is_ready(dev))
	return -ENODEV;

    memset(mgr, 0, sizeof(*mgr));
    mgr->dev = dev;

    ring_buf_init(&mgr->app_ring, sizeof(mgr->app_storage), mgr->app_storage);

    /* Async UART requires a callback before RX is enabled */
    int ret = uart_callback_set(dev, rx_uart_callback, mgr);

    if (ret != 0) {
        mgr->last_error = ret;
	return ret;
    }

    /* Transfer buffer A to the driver */
    mgr->driver_owned[0] = true;
    mgr->enabled = true;

    ret = uart_rx_enable(dev, mgr->driver_buf[0], RX_DRIVER_SIZE, SYS_FOREVER_US);

    if (ret != 0) {
        mgr->driver_owned[0] = false;
	mgr->enabled = false;
	mgr->last_error = ret;
        (void) uart_callback_set(dev, NULL, NULL);
    }

    return ret;
}


void rx_manager_event(struct rx_manager *mgr, const struct uart_event *evt) {
    if (mgr == NULL || evt == NULL)
	return;

    unsigned int key = irq_lock();

    switch (evt->type) {
	case UART_RX_RDY: {
	    int index = buffer_index(mgr, evt->data.rx.buf);
	    size_t offset = evt->data.rx.offset;
	    size_t len = evt->data.rx.len;

	    // verify that the event describes a valid span within one of our reusable driver buffers
	    if (index < 0 || !mgr->driver_owned[index] ||
                offset > RX_DRIVER_SIZE || len > RX_DRIVER_SIZE - offset) {
	        mgr->last_error = -EINVAL;
		break;
	    }

	    /* Zephyr RX_RDY semantics */
	    uint32_t copied = ring_buf_put(&mgr->app_ring, evt->data.rx.buf + offset, (uint32_t)len);

	    ++mgr->ready_events;
	    mgr->bytes_received += (uint32_t) len;
	    mgr->bytes_buffered += copied;
	    mgr->dropped_bytes += (uint32_t)len - copied;

	    break;
	}
	
	case UART_RX_BUF_REQUEST: {
	    int available = -1;

	    ++mgr->request_events;

	    for (size_t i = 0; i < RX_DRIVER_COUNT; ++i) {
                if (!mgr->driver_owned[i]) {
                    available = (int) i;
		    break;
		}
	    }

	    if (available < 0) {
	       mgr->last_error = -ENOBUFS;
	       break;
	    }

	    mgr->driver_owned[available] = true;

	    int ret = uart_rx_buf_rsp(mgr->dev, mgr->driver_buf[available], RX_DRIVER_SIZE);

	    if (ret != 0) {
		mgr->driver_owned[available] = false;
		mgr->last_error = ret;
	    }
	    break;
	}

	case UART_RX_BUF_RELEASED: {
	    int index = buffer_index(mgr, evt->data.rx_buf.buf);

	    if (index < 0 || !mgr->driver_owned[index]) {
                mgr->last_error = -EINVAL;
		break;
	    }

	    mgr->driver_owned[index] = false;
	    ++mgr->released_events; 

	    break;
	}

	case UART_RX_DISABLED:
	    mgr->enabled = false;
	    ++mgr->disabled_events;
	    break;

	case UART_RX_STOPPED:
	    ++mgr->stopped_events;
	    mgr->last_stop_reason = (uint32_t)evt->data.rx_stop.reason;
	    mgr->last_error = -EIO;
	    break;
	default:
	    break;
    }

    irq_unlock(key);
}

size_t rx_manager_read(struct rx_manager *mgr, uint8_t *dst, size_t max_len) {
    if (mgr == NULL || dst == NULL || max_len == 0U) {
        return 0U;
    }

    uint32_t limit = (uint32_t)MIN(max_len, (size_t)RX_RING_SIZE);
    unsigned int key = irq_lock();

    uint32_t count = ring_buf_get(&mgr->app_ring, dst, limit);
    mgr->bytes_read += count;
    irq_unlock(key);

    return count;
}
```

## src/rx_manager.h
```c
#ifndef LAB20_RX_MANAGER_H
#define LAB20_RX_MANAGER_H

#include <stdbool.h>
#include <stddef.h>
#include <stdint.h>

#include <zephyr/device.h>
#include <zephyr/drivers/uart.h>
#include <zephyr/sys/ring_buffer.h>

#define RX_DRIVER_COUNT 2U
#define RX_DRIVER_SIZE  8U
#define RX_RING_SIZE    64U

struct rx_manager {
    const struct device *dev;

    /* Temporary buffers whose ownership is transferred to the UART driver */
    uint8_t driver_buf[RX_DRIVER_COUNT][RX_DRIVER_SIZE];

    bool driver_owned[RX_DRIVER_COUNT];

    /* Persistent application-owned queue */
    struct ring_buf app_ring;
    uint8_t app_storage[RX_RING_SIZE];

    bool enabled;

    uint32_t ready_events;
    uint32_t request_events;
    uint32_t released_events;
    uint32_t disabled_events;
    uint32_t stopped_events;

    uint32_t bytes_received; // number of bytes reported by UART_RX_RDY
    uint32_t bytes_buffered; // number successfully copied into app_ring
    uint32_t bytes_read;     // number consumed by rx_manager_read()

    uint32_t dropped_bytes;
    uint32_t last_stop_reason;
    int last_error;
};

int rx_manager_init(struct rx_manager *mgr, const struct device *dev);

void rx_manager_event(struct rx_manager *mgr, const struct uart_event *evt);

size_t rx_manager_read(struct rx_manager *mgr, uint8_t *dst, size_t max_len);

#endif
```
