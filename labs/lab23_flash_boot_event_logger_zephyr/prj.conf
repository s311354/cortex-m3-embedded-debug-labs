## CMakeLists.txt
```
cmake_minimum_required(VERSION 3.20.0)

# Allow Zephyr to find this lab's local DT binding
list(APPEND DTS_ROOT "${CMAKE_CURRENT_SOURCE_DIR}")

find_package(Zephyr REQUIRED HINTS $ENV{ZEPHYR_BASE})

project(lab23_flash_boot_event_logger_zephyr LANGUAGES C)

target_sources(app PRIVATE
	src/main.c
	src/boot_log.c
)

target_include_directories(app PRIVATE
	"${CMAKE_CURRENT_SOURCE_DIR}/src"
)
```

## prj.conf
```kconfig
#
# FLASH
#
CONFIG_FLASH=y
CONFIG_FLASH_SIMULATOR=y
CONFIG_FLASH_SIMULATOR_EXPLICIT_ERASE=y
CONFIG_FLASH_SIMULATOR_DOUBLE_WRITES=n
CONFIG_FLASH_SIMULATOR_STATS=n

#
#
CONFIG_CONSOLE=n
CONFIG_PRINTK=n
CONFIG_LOG=n

#
# Debug-friendly build
#
CONFIG_DEBUG=y
CONFIG_NO_OPTIMIZATIONS=y
CONFIG_ASSERT=y

#
# Runtime
#
CONFIG_MAIN_STACK_SIZE=2048
```

## app.overlay
```dts
/*
* MPS2/AN385 already includes zephyr.sim-flash at a logical 0x0..0x7fff
*/
&storage_partition {
    reg = <0x00000000 0x7000>;
};

&flash_sim0 {
    partitions {
        bootlog_partition: partition@7000 {
            label = "bootlog_partition";
            reg = <0x00007000 0x1000>;
        };
    };
};
```

## src/main.c
```c
#include "boot_log.h"

#include <errno.h>
#include <stdint.h>
#include <string.h>

#include <zephyr/devicetree.h>
#include <zephyr/devicetree/fixed-partitions.h>
#include <zephyr/kernel.h>
#include <zephyr/sys/util.h>

#define BOOTLOG_PARTITION DT_NODELABEL(bootlog_partition)
#define BOOTLOG_FLASH     DT_MTD_FROM_FIXED_PARTITION(BOOTLOG_PARTITION)
#define BOOTLOG_BASE      ((off_t)DT_REG_ADDR(BOOTLOG_PARTITION))
#define BOOTLOG_BYTES     ((size_t)DT_REG_SIZE(BOOTLOG_PARTITION))
#define LAB23_NOT_RUN     (-999)

BUILD_ASSERT(DT_NODE_EXISTS(BOOTLOG_FLASH), "bootlog partition must belong to a flash driver");
BUILD_ASSERT(DT_NODE_HAS_STATUS(BOOTLOG_FLASH, okay), "MPS2 flash simulator must be enabled");
BUILD_ASSERT((BOOTLOG_BYTES % BOOT_LOG_RECORD_SIZE) == 0U, "bootlog partition needs whole 16-byte slots");
BUILD_ASSERT(BOOTLOG_BYTES >= 2U * BOOT_LOG_RECORD_SIZE, "bootlog demo requires at least two slots");

enum lab23_stage {
    LAB23_STAGE_RESET = 0,
    LAB23_STAGE_INIT,
    LAB23_STAGE_EMPTY_CHECK,
    LAB23_STAGE_APPEND_FIRST,
    LAB23_STAGE_APPEND_SECOND,
    LAB23_STAGE_RECOVER,
    LAB23_STAGE_READ_LAST,
    LAB23_STAGE_DONE,
    LAB23_STAGE_ERROR
};

static struct boot_log g_log;
static struct boot_log g_recovered_log;
static const struct device *const g_flash = DEVICE_DT_GET(BOOTLOG_FLASH);

static const uint8_t g_record_a[BOOT_LOG_RECORD_SIZE] = {
    0x42, 0x4f, 0x4f, 0x54, 0x01, 0x00, 0x00, 0x01,
    0x11, 0x22, 0x33, 0x44, 0x55, 0x66, 0x77, 0x88
};

static const uint8_t g_record_b[BOOT_LOG_RECORD_SIZE] = {
    0x42, 0x4f, 0x4f, 0x54, 0x02, 0x00, 0x00, 0x02,
    0x99, 0xaa, 0xbb, 0xcc, 0xdd, 0xee, 0xf0, 0x0f
};

volatile enum lab23_stage g_lab23_stage;
volatile enum lab23_stage g_lab23_failed_stage;

volatile int g_init_rc = LAB23_NOT_RUN;
volatile int g_empty_rc = LAB23_NOT_RUN;
volatile int g_append_a_rc = LAB23_NOT_RUN;
volatile int g_append_b_rc = LAB23_NOT_RUN;
volatile int g_recover_rc = LAB23_NOT_RUN;
volatile int g_read_last_rc = LAB23_NOT_RUN;
volatile int g_compare_rc = LAB23_NOT_RUN;

volatile size_t g_initial_next_slot;
volatile size_t g_recovered_next_slot;
volatile size_t g_capacity_slots;

volatile uint8_t g_erase_value;
volatile uint8_t g_last_record[BOOT_LOG_RECORD_SIZE];

__attribute__ ((noinline)) void lab23_checkpoint(void) {
    __asm__ volatile ("nop");
}

static void halt_lab(void) {
    lab23_checkpoint();
    for (;;) {
        k_sleep(K_FOREVER);
    }
}

static void fail_lab(void) {
    g_lab23_failed_stage = g_lab23_stage;
    g_lab23_stage = LAB23_STAGE_ERROR;
    halt_lab();
}

int main(void) {
    uint8_t last[BOOT_LOG_RECORD_SIZE];
    g_lab23_stage = LAB23_STAGE_RESET;
    g_lab23_failed_stage = LAB23_STAGE_RESET;

    /* TEST1. */
    g_lab23_stage = LAB23_STAGE_INIT;
    lab23_checkpoint();

    g_init_rc = boot_log_init(&g_log, g_flash, BOOTLOG_BASE, BOOTLOG_BYTES);

    if (g_init_rc != 0)
	fail_lab();

    g_initial_next_slot = g_log.next_slot;
    g_capacity_slots = g_log.region_size / BOOT_LOG_RECORD_SIZE;
    g_erase_value = g_log.erase_value;

    /* TEST2. */
    g_lab23_stage = LAB23_STAGE_EMPTY_CHECK;
    lab23_checkpoint();

    if (g_log.next_slot == 0U) {
        g_empty_rc = boot_log_read_last(&g_log, last);

	if (g_empty_rc != -ENOENT )
            fail_lab();
    }

    if (g_capacity_slots - g_initial_next_slot < 2U) {
        fail_lab();
    }

    /* TEST3. */
    g_lab23_stage = LAB23_STAGE_APPEND_FIRST;
    lab23_checkpoint();

    g_append_a_rc = boot_log_append(&g_log, g_record_a);

    if (g_append_a_rc != 0) 
	fail_lab();

    g_lab23_stage = LAB23_STAGE_APPEND_SECOND;
    lab23_checkpoint();

    g_append_b_rc = boot_log_append(&g_log, g_record_b);

    if (g_append_b_rc != 0)
	fail_lab();

    /* TEST4. */
    g_lab23_stage = LAB23_STAGE_RECOVER;
    lab23_checkpoint();

    g_recover_rc = boot_log_init(&g_recovered_log, g_flash, BOOTLOG_BASE, BOOTLOG_BYTES);

    if (g_recover_rc != 0 || g_recovered_log.next_slot != g_initial_next_slot + 2U) {
        fail_lab();
    }

    g_recovered_next_slot = g_recovered_log.next_slot;

    /* TEST5. */
    g_lab23_stage = LAB23_STAGE_READ_LAST;
    lab23_checkpoint();

    g_read_last_rc = boot_log_read_last(&g_recovered_log, last);

    if (g_read_last_rc != 0)
	fail_lab();

    g_compare_rc = memcmp(last, g_record_b, sizeof(last));
    memcpy((void *)g_last_record, last, sizeof(last));

    if (g_compare_rc != 0)
	fail_lab();

    g_lab23_stage = LAB23_STAGE_DONE;
    halt_lab();
    return 0;
}
```

## src/boot_log.c
```c
#include "boot_log.h"

#include <errno.h>
#include <limits.h>
#include <stdint.h>
#include <string.h>

#include <zephyr/drivers/flash.h>

static bool is_erased(const uint8_t *data, uint8_t erase_value) {
    for (size_t i = 0U; i < BOOT_LOG_RECORD_SIZE; ++i) {
        if (data[i] != erase_value) {
	    return false;
	}
    }

    return true;
}

static off_t slot_offset(const struct boot_log *log, size_t index) {
    return log->base + (off_t) (index * BOOT_LOG_RECORD_SIZE);	
}

int boot_log_init(struct boot_log *log, const struct device *dev, off_t base, size_t region_size) {
    if (log == NULL)
	return -EINVAL;

    memset(log, 0, sizeof(*log));

    if (dev == NULL || base < 0 || region_size < BOOT_LOG_RECORD_SIZE || (region_size % BOOT_LOG_RECORD_SIZE) != 0U) {
        return -EINVAL;
    }

    const uint64_t off_max = (sizeof(off_t) <= sizeof(int32_t)) ? (uint64_t) INT32_MAX : (uint64_t) INT64_MAX;

    if ((uint64_t) base > off_max || (uint64_t) region_size > off_max - (uint64_t) base) {
        return -EINVAL;
    }

    if (!device_is_ready(dev))
	return -ENODEV;

    const size_t write_block = flash_get_write_block_size(dev);

    if (write_block == 0U || (BOOT_LOG_RECORD_SIZE % write_block) != 0U || ((uint64_t) base % write_block) != 0U) {
        return -ENOTSUP;
    }

    const struct flash_parameters *params = flash_get_parameters(dev);

    if (params == NULL)
	return -ENOTSUP;

    log->dev = dev;
    log->base = base;
    log->region_size = region_size;
    log->erase_value = params->erase_value;

    const size_t capacity = region_size / BOOT_LOG_RECORD_SIZE;
    bool found_empty = false;
    uint8_t data[BOOT_LOG_RECORD_SIZE];

    for (size_t index = 0U; index < capacity; ++index) {
        const int rc = flash_read(dev, slot_offset(log, index), data, sizeof(data));

	if (rc != 0)
            return rc;

	if (is_erased(data, log->erase_value)) {
	    found_empty = true;
	} else {
	    if (found_empty) {
	        return -EILSEQ;
	    }

	    log->next_slot = index + 1U;
	}
    }

    log->initialized = true;
    return 0;
}

int boot_log_append(struct boot_log *log, const uint8_t record[BOOT_LOG_RECORD_SIZE]) {
    if (log == NULL || record == NULL || !log->initialized || log->dev == NULL) 
	return -EINVAL;

    if (!device_is_ready(log->dev))
	return -ENODEV;

    if (is_erased(record, log->erase_value))
	return -EINVAL;

    if (log->next_slot >= log->region_size / BOOT_LOG_RECORD_SIZE)
	return -ENOSPC;

    const off_t offset = slot_offset(log, log->next_slot);
    uint8_t check[BOOT_LOG_RECORD_SIZE];
    int rc = flash_read(log->dev, offset, check, sizeof(check));

    if (rc != 0)
	return rc;

    if (!is_erased(check, log->erase_value)) {
        log->initialized = false;
	return -EEXIST;
    }

    log->initialized = false;
    rc = flash_write(log->dev, offset, record, BOOT_LOG_RECORD_SIZE);

    if (rc != 0)
	return rc;

    rc = flash_read(log->dev, offset, check, sizeof(check));

    if (rc != 0)
	return rc;

    if (memcmp(check, record, BOOT_LOG_RECORD_SIZE) != 0)
	return -EIO;

    ++log->next_slot;
    log->initialized = true;
    return 0;
}

int boot_log_read_last(const struct boot_log *log, uint8_t out[BOOT_LOG_RECORD_SIZE]) {
    if (log == NULL || out == NULL || !log->initialized || log->dev == NULL)
	return -EINVAL;

    if (!device_is_ready(log->dev))
	return -ENODEV;

    if (log->next_slot == 0U)
	return -ENOENT;

    const int rc = flash_read(log->dev, slot_offset(log, log->next_slot - 1U), out, BOOT_LOG_RECORD_SIZE);

    if (rc != 0)
	return rc;

    return is_erased(out, log->erase_value) ? -EIO : 0;

}
```

## src/boot_log.h
```c
#ifndef LAB23_BOOT_LOG_H
#define LAB23_BOOT_LOG_H

#include <stdbool.h>
#include <stddef.h>
#include <stdint.h>
#include <sys/types.h>

#include <zephyr/device.h>

#define BOOT_LOG_RECORD_SIZE 16U

struct boot_log {
    const struct device *dev;

    off_t base;
    size_t region_size;
    size_t next_slot;
    uint8_t erase_value;
    bool initialized;
};

int boot_log_init(struct boot_log *log, const struct device *dev, off_t base, size_t region_size);

int boot_log_append(struct boot_log *log, const uint8_t record[BOOT_LOG_RECORD_SIZE]);

int boot_log_read_last(const struct boot_log *log, uint8_t out[BOOT_LOG_RECORD_SIZE]);

#endif
```
